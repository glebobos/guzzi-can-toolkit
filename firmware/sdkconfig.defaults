## firmware/sdkconfig.defaults
```kconfig
# ESP-IDF Configuration Defaults for Moto Guzzi CAN Toolkit

# Target Customization
CONFIG_IDF_TARGET="esp32c3"

# Partition Table
CONFIG_PARTITION_TABLE_CUSTOM=y
CONFIG_PARTITION_TABLE_CUSTOM_FILENAME="partitions.csv"

# Wi-Fi & TCP/IP
CONFIG_ESP_WIFI_SOFTAP_SUPPORT=y
CONFIG_LWIP_MAX_SOCKETS=16

# HTTP Server & WebSockets
CONFIG_HTTPD_MAX_REQ_HDR_LEN=1024
CONFIG_HTTPD_MAX_URI_LEN=512
CONFIG_HTTPD_WS_SUPPORT=y

# FreeRTOS
CONFIG_FREERTOS_HZ=1000

# Compiler Optimization
CONFIG_COMPILER_OPTIMIZATION_PERF=y
```
